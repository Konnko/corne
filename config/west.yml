## config/west.yml
```yaml
manifest:
  remotes:
    - name: konnko
      url-base: https://github.com/Konnko
  projects:
    - name: zmk
      remote: konnko
      revision: niceview-tearing-fix
      import: app/west.yml
  self:
    path: config
```
